## main/Kconfig.projbuild
```kconfig
menu "CSI Breathing Monitor"

    config CSI_TCP_HOST
        string "Capture machine IP address"
        default "192.168.0.100"
        help
            IPv4 address of the host machine running capture.py.
            The ESP32 connects here as a TCP client and streams CSI rows.

    config CSI_TCP_PORT
        int "TCP port"
        default 3490
        range 1024 65535
        help
            TCP port on which capture.py is listening (default 3490).

    config SEND_FREQUENCY
        int "Ping rate (Hz)"
        default 100
        range 10 1000
        help
            How many ICMP pings per second are sent to the gateway.
            Each ping triggers one CSI frame, so this is the CSI sample rate.
            Higher values give better time resolution but increase CPU and
            network load. 100 Hz is the recommended default.

    menu "Environment sensors (LDR + AM2302)"

        config ENV_ENABLE
            bool "Enable wired environment sensors"
            default n
            help
                Master switch for the wired light (LDR/CdS) and
                temperature/humidity (AM2302/DHT22) sensors. When enabled a
                dedicated task samples them and emits a low-rate MSG_ENV
                message to the capture host. Independent of the CSI path.

        config ENV_EMIT_HZ
            int "Env emit rate (Hz)"
            depends on ENV_ENABLE
            default 1
            range 1 10
            help
                How often MSG_ENV is sent. The AM2302 only updates every
                ~2 s, so values above ~1 Hz just resend cached temp/RH with
                fresh LDR readings.

        config ENV_LDR_ENABLE
            bool "Enable LDR (CdS) light sensor"
            depends on ENV_ENABLE
            default y

        config ENV_LDR_ADC1_CHANNEL
            int "LDR ADC1 channel"
            depends on ENV_LDR_ENABLE
            default 6
            range 0 9
            help
                ADC1 channel index for the LDR divider node. MUST be ADC1 —
                ADC2 is unusable while Wi-Fi is active. Classic ESP32: ch0-7
                = GPIO36,37,38,39,32,33,34,35. ESP32-S3: ch0-9 = GPIO1-10.

        config ENV_LDR_RFIX_OHM
            int "LDR divider fixed resistor (ohm)"
            depends on ENV_LDR_ENABLE
            default 10000
            help
                Value of the fixed leg in the 3V3-LDR-node-Rfix-GND divider.
                Used host-side for the lux estimate; keep in sync there.

        config ENV_AM2302_ENABLE
            bool "Enable AM2302 (DHT22) temp/humidity sensor"
            depends on ENV_ENABLE
            default y

        config ENV_AM2302_GPIO
            int "AM2302 data GPIO"
            depends on ENV_AM2302_ENABLE
            default 4
            range 0 48
            help
                GPIO wired to the AM2302 DATA line (needs a 4.7k-10k pull-up
                to 3V3). Pick a normal GPIO — avoid strapping pins and the
                input-only GPIO34-39 on the classic ESP32.

    endmenu

endmenu
```

## smart-plug/main/Kconfig.projbuild
```kconfig
menu "Mecha Smart Plug"

    config PLUG_RELAY_GPIO
        int "Relay control GPIO pin"
        default 21
        range 0 48
        help
            GPIO pin that drives the low-current signal-relay coil (see the
            hardware topology / V54 in SPEC.md). 21 is a safe default on both
            ESP32 and ESP32-S3. Avoid input-only pins (ESP32 GPIO 34-39),
            strapping pins (ESP32 0/2/12/15; S3 0/3/45/46), and any pin wired
            to flash/PSRAM. Range 0-48 covers ESP32 (0-39) and ESP32-S3 (0-48).

    config PLUG_RELAY_ACTIVE_HIGH
        bool "Relay is active-high"
        default y
        help
            y: GPIO HIGH energises the relay (ON), LOW de-energises (OFF).
            n: inverted, for boards with an active-low relay driver. The
            fail-closed OFF level is always the de-energised level, whichever
            polarity this selects.

    config PLUG_HTTP_PORT
        int "HTTP server port"
        default 80
        range 1 65535
        help
            Port for the REST API. The app discovers this via the mDNS SRV
            record, so non-default ports work, but 80 matches FIRMWARE.md.

    config PLUG_NAME
        string "Initial plug name"
        default "Mecha Plug"
        help
            Seed value for the `name` mDNS TXT record and the JSON `name`
            field on first boot. Persisted to NVS thereafter.

    config PLUG_WATCHDOG_S
        int "Fail-closed watchdog (seconds)"
        default 30
        range 5 600
        help
            If no POST /relay or POST /heartbeat arrives within this window,
            the relay is forced OFF (V50). Must match the app's WATCHDOG_S
            (30 s); changing it changes the safety margin the app assumes.

endmenu
```

## smart-plug/sdkconfig.defaults
```kconfig
#
# Mecha smart-plug defaults. Minimal — no CSI/high-rate-streaming tuning here.
#

#
# CPU
#
CONFIG_ESP32_DEFAULT_CPU_FREQ_240=y
CONFIG_ESP32_DEFAULT_CPU_FREQ_MHZ=240
CONFIG_ESP32S3_DEFAULT_CPU_FREQ_240=y
CONFIG_ESP32S3_DEFAULT_CPU_FREQ_MHZ=240

#
# Console / monitor baud (matches the CSI firmware for tooling parity)
#
CONFIG_ESP_CONSOLE_UART_CUSTOM=y
CONFIG_ESP_CONSOLE_UART=y
CONFIG_ESP_CONSOLE_UART_NUM=0
CONFIG_CONSOLE_UART_BAUDRATE=921600
CONFIG_ESPTOOLPY_MONITOR_BAUD_921600B=y
CONFIG_ESPTOOLPY_MONITOR_BAUD=921600
```
